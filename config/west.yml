## config/west.yml
```yaml
manifest:
  remotes:
    - name: projection-org
      url-base: https://github.com/projection-org
  projects:
    - name: zmk
      remote: projection-org
      revision: main
      import: app/west.yml
  self:
    path: config
```
